#define CONFIG_WIRELESS
#define LILY58_STANDARD_LABELS // Number row on LN*, letters on LT*/LM*/LB*.
#include "zmk-helpers/key-labels/lily58.h"

#include <behaviors.dtsi>
#include <behaviors/num_word.dtsi> // Requires zmk-auto-layer module.
#include <behaviors/unicode.dtsi> // Requires zmk-unicode module.
#include <zmk-helpers/helper.h> // Requires zmk-helpers module.
#include <dt-bindings/zmk/keys.h>
#ifdef CONFIG_WIRELESS
  #include <dt-bindings/zmk/bt.h>
  #include <dt-bindings/zmk/outputs.h>
  #define _BT_SEL_KEYS_                                                        \
      &bt BT_SEL 0 &bt BT_SEL 1 &bt BT_SEL 2 &bt BT_SEL 3 &bt BT_CLR
#else
  #define _BT_SEL_KEYS_ &trans &trans &trans &trans &trans
#endif

#define DEF 0
#define NAV 1
#define FN 2
#define NUM 3
#define SYS 4
#define MOUSE 5

#define XXX &none
#define ___ &trans

/* Global defaults */

#define QUICK_TAP_MS 175

&sk {
  release-after-ms = <900>;
  quick-release;
};

&sl { // Allow sticky mods to chord across sticky layers.
  ignore-modifiers;
};

&lt {
  flavor = "balanced";
  tapping-term-ms = <200>;
  quick-tap-ms = <QUICK_TAP_MS>;
};

/* Homerow mods */

#define MAKE_HRM(NAME, HOLD, TAP, TRIGGER_POS)                                 \
  ZMK_HOLD_TAP(NAME, bindings = <HOLD>, <TAP>; flavor = "balanced";            \
               tapping-term-ms = <280>; quick-tap-ms = <QUICK_TAP_MS>;         \
               require-prior-idle-ms = <150>; hold-trigger-on-release;         \
               hold-trigger-key-positions = <TRIGGER_POS>;)

MAKE_HRM(hml, &kp, &kp, KEYS_R THUMBS) // Left-hand HRMs.
MAKE_HRM(hmr, &kp, &kp, KEYS_L THUMBS) // Right-hand HRMs.

// Hack: Make HRM combos tap-only (cf, ZMK issue #544).
#define ZMK_COMBO_8(NAME, TAP, POS, LAYERS, COMBO_MS, IDLE_MS, HOLD, SIDE)     \
  MAKE_HRM(hm_combo_##NAME, &kp, TAP, SIDE THUMBS)                             \
  ZMK_COMBO_6(NAME, &hm_combo_##NAME HOLD 0, POS, LAYERS, COMBO_MS, IDLE_MS)

/* Combos, leader key sequences, mouse emulation */

#include "combos.dtsi" // Must be sourced after HRM-combo hack.
#include "leader.dtsi"
#include "mouse.dtsi"

/* Nav cluster */

// Trigger tap-action on all interrupts.
#define MT_CORE                                                                \
  flavor = "tap-preferred";                                                    \
  tapping-term-ms = <220>;                                                     \
  quick-tap-ms = <220>;                                                        \
  hold-trigger-key-positions = <0>;

&mt { MT_CORE };

ZMK_HOLD_TAP(mt_home, bindings = <&masked_home>, <&kp>; MT_CORE)
ZMK_HOLD_TAP(mt_end, bindings = <&masked_end>, <&kp>; MT_CORE)

#define NAV_LEFT  &mt_home 0   LEFT  // Tap: left  | Long-tap: start of line.
#define NAV_RIGHT &mt_end 0    RIGHT // Tap: right | Long-tap: end   of line.
#define NAV_UP    &mt LC(HOME) UP    // Tap: up    | Long-tap: start of doc.
#define NAV_DOWN  &mt LC(END)  DOWN  // Tap: down  | Long-tap: end   of doc.
#define NAV_BSPC  &mt LC(BSPC) BSPC  // Tap: bspc  | Long-tap: delete word bwd.
#define NAV_DEL   &mt LC(DEL)  DEL   // Tap: del   | Long-tap: delete word fwd.

// Mask CTRL on left/right hold to avoid accidental jumps to start/end of doc.
#define MASK_MODS(NAME, MODS, BINDING)                                         \
  ZMK_MOD_MORPH(NAME, bindings = <BINDING>, <BINDING>; mods = <MODS>;)

MASK_MODS(masked_home, (MOD_LCTL), &kp HOME)
MASK_MODS(masked_end,  (MOD_LCTL), &kp END)

/* Magic-shift & auto-layers */

// Tap: repeat after alpha, else sticky-shift |
// Shift + tap/ double-tap: caps-word | Hold: shift.
#define MAGIC_SHIFT &magic_shift LSHFT 0
ZMK_HOLD_TAP(magic_shift, bindings = <&kp>, <&magic_shift_tap>;
             flavor = "balanced"; tapping-term-ms = <200>;
             quick-tap-ms = <QUICK_TAP_MS>;)
ZMK_MOD_MORPH(magic_shift_tap, bindings = <&shift_repeat>, <&caps_word>;
              mods = <(MOD_LSFT)>;)
ZMK_ADAPTIVE_KEY(
    shift_repeat, bindings = <&sk LSHFT>;
    repeat {
      trigger-keys = <A B C D E F G H I J K L M N O P Q R S T U V W X Y Z>;
      bindings = <&key_repeat>;
      max-prior-idle-ms = <1200>;
      strict-modifiers;
    };)
&caps_word { // Mods deactivate caps-word, requires PR #1451. [TODO: rebase]
  /delete-property/ ignore-modifiers;
};

// Tap: num-word | double-tap: sticky num-layer | Hold: num-layer.
#define SMART_NUM &smart_num NUM 0
ZMK_HOLD_TAP(smart_num, bindings = <&mo>, <&num_dance>; flavor = "balanced";
             tapping-term-ms = <200>; quick-tap-ms = <QUICK_TAP_MS>;)
ZMK_TAP_DANCE(num_dance, bindings = <&num_word NUM>, <&sl NUM>;
              tapping-term-ms = <200>;)

// Smart-mouse, requires tri-state module.
ZMK_TRI_STATE(
    smart_mouse, bindings = <&tog MOUSE>, <&none>, <&tog MOUSE>;
    ignored-key-positions =
        <LT1 LT2 LH0 LH1 LH2 LH3 RT1 RT2 RT3 RM0 RM1 RM2 RM3 RM4 RB1 RB2 RB3 RH0 RH1>;
    ignored-layers = <MOUSE NAV FN>;)

/* Custom behaviors */

// Hold: mod | Tap: key, only after typing has paused (avoids misfires mid-word).
ZMK_HOLD_TAP(rpi, bindings = <&kp>, <&kp>; flavor = "tap-preferred";
             tapping-term-ms = <200>; quick-tap-ms = <200>;
             require-prior-idle-ms = <125>;)

// Tap: key | Hold: key, only after the full tapping term (interrupts stay taps).
ZMK_HOLD_TAP(long_hold, bindings = <&kp>, <&kp>; flavor = "tap-preferred";
             tapping-term-ms = <250>;)

// Tap: next workspace | Hold: super.
ZMK_HOLD_TAP(super_thumb, bindings = <&kp>, <&kp>; flavor = "hold-preferred";
             tapping-term-ms = <200>; quick-tap-ms = <QUICK_TAP_MS>;)

// Alt+Tab swapper, requires tri-state module.
ZMK_TRI_STATE(swapper, bindings = <&kt LALT>, <&kp TAB>, <&kt LALT>;
              ignored-key-positions = <LT2 RT2 RM1 RM2 RM3>;)

// Define mod-morph with a *single* mod trigger for less repetition.
#define SIMPLE_MORPH(NAME, MOD, BINDING1, BINDING2)                            \
  ZMK_MOD_MORPH(NAME, mods = <(MOD_L##MOD | MOD_R##MOD)>;                      \
                bindings = <BINDING1>, <BINDING2>;)

// Tap: comma | Shift + tap: semicolon | Ctrl + shift + tap: <.
SIMPLE_MORPH(comma_morph, SFT, &kp COMMA, &comma_inner_morph)
SIMPLE_MORPH(comma_inner_morph, CTL, &kp SEMICOLON, &kp LESS_THAN)

// Tap: dot | Shift + tap: colon | Ctrl + shift + tap: >.
SIMPLE_MORPH(dot_morph, SFT, &kp DOT, &dot_inner_morph)
SIMPLE_MORPH(dot_inner_morph, CTL, &kp COLON, &kp GREATER_THAN)

// Tap: qmark | Shift + tap: excl.
SIMPLE_MORPH(qexcl, SFT, &kp QMARK, &kp EXCL)

// Tap: left/right parenthesis | Shft + tap: less-than/greater-than.
SIMPLE_MORPH(lpar_lt, SFT, &kp LPAR, &kp LT)
SIMPLE_MORPH(rpar_gt, SFT, &kp RPAR, &kp GT)

// Tap: space | Shift + tap: dot -> space -> sticky shift | Hold: nav layer.
ZMK_HOLD_TAP(lt_spc, bindings = <&mo>, <&spc_morph>; flavor = "balanced";
             tapping-term-ms = <200>; quick-tap-ms = <QUICK_TAP_MS>;)
SIMPLE_MORPH(spc_morph, SFT, &kp SPACE, &dot_spc)
ZMK_MACRO(dot_spc, bindings = <&kp DOT &kp SPACE &sk LSHFT>; wait-ms = <0>;
          tap-ms = <5>;)

// Tap: backspace | Lshft + tap: delete | Rshft + tap: shift-delete.
ZMK_MOD_MORPH(bs_del, bindings = <&kp BSPC>, <&kp DEL>;
              mods = <(MOD_LSFT|MOD_RSFT)>; keep-mods = <MOD_RSFT>;)

// Tap: escape | Hold: ctrl.
ZMK_HOLD_TAP(ctl_esc, bindings = <&kp>, <&kp>; flavor = "balanced";
             tapping-term-ms = <200>; quick-tap-ms = <QUICK_TAP_MS>;)

// Tap: copy | double-tap: cut | Hold: paste.
#define COPY_CUT &copy_cut LS(INS) 0
ZMK_HOLD_TAP(copy_cut, bindings = <&kp>, <&copy_cut_dance>;
             flavor = "tap-preferred"; tapping-term-ms = <200>;
             quick-tap-ms = <QUICK_TAP_MS>;)
ZMK_TAP_DANCE(copy_cut_dance, bindings = <&kp LC(INS)>, <&kp LC(X)>;
              tapping-term-ms = <200>;)

// Sticky shift + leader.
ZMK_MACRO(leader_sft, bindings = <&sk LSHFT &leader>;)

// Misc aliases. [TODO: clean up]
#define CANCEL       &kp K_CANCEL                  // Cancel caps-word & auto-layers.
#define CLOSE_WIN    &rpi LGUI RG(RS(Q))           // Close application
#define MAPP_LEFT    &kp LG(LS(LEFT))              // Move application left 1 monitor
#define MAPP_UP      &kp RG(RS(UP))                // Move application up 1 monitor
#define MAPP_DOWN    &kp RG(RS(DOWN))              // Move application down 1 monitor
#define MAPP_RIGHT   &kp RG(RS(RIGHT))             // Move application right 1 monitor
#define MWKSP_LEFT   &rpi LGUI RG(RC(RS(LEFT)))    // Move workspace left 1 monitor
#define MWKSP_UP     &rpi LALT RG(RC(RS(UP)))      // Move workspace up 1 monitor
#define MWKSP_DOWN   &rpi LSHIFT RG(RC(RS(DOWN)))  // Move workspace down 1 monitor
#define MWKSP_RIGHT  &rpi LSHIFT RG(RC(RS(RIGHT))) // Move workspace right 1 monitor
#define PREV_COL     &kp LG(LEFT)                  // Move application left 1 column on same monitor
#define PREV_WKSP    &kp LG(UP)                    // Move application up 1 workspace on same monitor
#define NEXT_WKSP    &kp RG(DOWN)                  // Move application down 1 workspace on same monitor
#define NEXT_COL     &kp LG(RIGHT)                 // Move application right 1 columnn on same monitor
#define SCRSHOT      &kp RG(RS(PRINTSCREEN))       // Take a system screenshot
#define LAUNCHER     &kp LG(SPACE)                 // Toggle app launcher
#define CLIP_HIST    &long_hold LG(V) LS(LC(C))    // Tap: terminal copy | Hold: clipboard history
#define SUPER_WS     &super_thumb LGUI LG(TAB)     // Tap: next workspace | Hold: super

&soft_off {
  hold-time-ms = <2000>; // Only turn off it the key is held for 2 seconds or longer.
};

/* Keymap */

ZMK_CONDITIONAL_LAYER(sys, FN NUM, SYS) // FN + NUM --> SYS.

ZMK_LAYER(Base,
//╭─────────────┬─────────────┬─────────────┬─────────────┬─────────────┬─────────────╮                             ╭─────────────┬─────────────┬─────────────┬─────────────┬─────────────┬─────────────╮
    &kp GRAVE     &kp N1        &kp N2        &kp N3        &kp N4        &kp N5                                      &kp N6        &kp N7        &kp N8        &kp N9        &kp N0         &kp BSLH
//├─────────────┼─────────────┼─────────────┼─────────────┼─────────────┼─────────────┤                             ├─────────────┼─────────────┼─────────────┼─────────────┼─────────────┼─────────────┤
    &kp TAB       &kp Q         &kp W         &kp E         &kp R         &kp T                                       &kp Y         &kp U         &kp I         &kp O         &kp P          &kp MINUS
//├─────────────┼─────────────┼─────────────┼─────────────┼─────────────┼─────────────┤                             ├─────────────┼─────────────┼─────────────┼─────────────┼─────────────┼─────────────┤
    SUPER_WS      &hml LALT A   &hml LGUI S   &hml LCTRL D  &hml LSHFT F  &kp G                                       &kp H         &hmr RSHFT J  &hmr RCTRL K  &hmr RGUI L   &hmr RALT SEMI &kp SQT
//├─────────────┼─────────────┼─────────────┼─────────────┼─────────────┼─────────────┼─────────────╮ ╭─────────────┼─────────────┼─────────────┼─────────────┼─────────────┼─────────────┼─────────────┤
    LAUNCHER     &kp Z         &kp X         &kp C         &kp V         &kp B         &kp LBKT        &kp RBKT      &kp N         &kp M         &kp COMMA     &kp DOT       &kp FSLH       &kp EQUAL
//╰─────────────┴─────────────┴─────────────┼─────────────┼─────────────┼─────────────┼─────────────┤ ├─────────────┼─────────────┼─────────────┼─────────────┼─────────────┴─────────────┴─────────────╯
                                              COPY_CUT      SMART_NUM     &kp DEL       &lt FN RET      &lt_spc NAV 0 &bs_del       MAGIC_SHIFT    CLIP_HIST
//                                          ╰─────────────┴─────────────┴─────────────┴─────────────╯ ╰─────────────┴─────────────┴─────────────┴─────────────╯
)

ZMK_LAYER(Nav,
//╭─────────────┬─────────────┬─────────────┬─────────────┬─────────────┬─────────────╮                             ╭─────────────┬─────────────┬─────────────┬─────────────┬─────────────┬─────────────╮
    &kp ESC       ___           ___           ___           ___           ___                                         ___           ___           ___           ___           ___           ___
//├─────────────┼─────────────┼─────────────┼─────────────┼─────────────┼─────────────┤                             ├─────────────┼─────────────┼─────────────┼─────────────┼─────────────┼─────────────┤
    ___           CLOSE_WIN     MAPP_LEFT     MAPP_UP       MAPP_DOWN     MAPP_RIGHT                                  &kp PG_UP     NAV_BSPC      NAV_UP        NAV_DEL       ___           ___
//├─────────────┼─────────────┼─────────────┼─────────────┼─────────────┼─────────────┤                             ├─────────────┼─────────────┼─────────────┼─────────────┼─────────────┼─────────────┤
    ___           ___           MWKSP_LEFT    MWKSP_UP      MWKSP_DOWN    MWKSP_RIGHT                                 &kp PG_DN     NAV_LEFT      NAV_DOWN      NAV_RIGHT     &kp RET       ___
//├─────────────┼─────────────┼─────────────┼─────────────┼─────────────┼─────────────┼─────────────╮ ╭─────────────┼─────────────┼─────────────┼─────────────┼─────────────┼─────────────┼─────────────┤
    &tog 1        ___           PREV_COL      PREV_WKSP     NEXT_WKSP     NEXT_COL      ___             ___           &kp INS       &kp TAB       ___           ___           ___           &tog 1
//╰─────────────┴─────────────┴─────────────┼─────────────┼─────────────┼─────────────┼─────────────┤ ├─────────────┼─────────────┼─────────────┼─────────────┼─────────────┴─────────────┴─────────────╯
                                              ___           ___           ___           ___             ___           CANCEL        ___           ___
//                                          ╰─────────────┴─────────────┴─────────────┴─────────────╯ ╰─────────────┴─────────────┴─────────────┴─────────────╯
)

ZMK_LAYER(Fn,
//╭─────────────┬─────────────┬─────────────┬─────────────┬─────────────┬─────────────╮                             ╭─────────────┬─────────────┬─────────────┬─────────────┬─────────────┬─────────────╮
    &kp F1        &kp F2        &kp F3        &kp F4        &kp F5        &kp F6                                      &kp F7        &kp F8         &kp F9        &kp F10       &kp F11       &kp F12
//├─────────────┼─────────────┼─────────────┼─────────────┼─────────────┼─────────────┤                             ├─────────────┼─────────────┼─────────────┼─────────────┼─────────────┼─────────────┤
    &kp C_PREV    &kp C_PLAY_PAUSE &kp C_NEXT  &kp C_VOL_DN  &kp C_MUTE    &kp C_VOL_UP                               ___           ___            &kp UP        ___           ___           ___
//├─────────────┼─────────────┼─────────────┼─────────────┼─────────────┼─────────────┤                             ├─────────────┼─────────────┼─────────────┼─────────────┼─────────────┼─────────────┤
    ___           ___           ___           ___           ___           ___                                         ___           &kp LEFT       &kp DOWN      &kp RIGHT     ___           ___
//├─────────────┼─────────────┼─────────────┼─────────────┼─────────────┼─────────────┼─────────────╮ ╭─────────────┼─────────────┼─────────────┼─────────────┼─────────────┼─────────────┼─────────────┤
    &tog 2        ___           ___           ___           ___           ___           SCRSHOT         &soft_off     ___           ___            ___           ___           ___           &tog 2
//╰─────────────┴─────────────┴─────────────┼─────────────┼─────────────┼─────────────┼─────────────┤ ├─────────────┼─────────────┼─────────────┼─────────────┼─────────────┴─────────────┴─────────────╯
                                              ___           ___           ___           ___             ___           ___           ___           ___
//                                          ╰─────────────┴─────────────┴─────────────┴─────────────╯ ╰─────────────┴─────────────┴─────────────┴─────────────╯
)

ZMK_LAYER(Num,
//╭─────────────┬─────────────┬─────────────┬─────────────┬─────────────┬─────────────╮                             ╭─────────────┬─────────────┬─────────────┬─────────────┬─────────────┬─────────────╮
    ___           ___           ___           ___           ___           ___                                         ___           ___           ___           ___           ___           ___
//├─────────────┼─────────────┼─────────────┼─────────────┼─────────────┼─────────────┤                             ├─────────────┼─────────────┼─────────────┼─────────────┼─────────────┼─────────────┤
    ___           ___           ___           ___           ___           ___                                         ___           &kp N7        &kp N8        &kp N9        ___           ___
//├─────────────┼─────────────┼─────────────┼─────────────┼─────────────┼─────────────┤                             ├─────────────┼─────────────┼─────────────┼─────────────┼─────────────┼─────────────┤
    ___           ___           ___           ___           ___           ___                                         ___           &hml RCTRL N4 &hml RSHFT N5 &hml RALT N6  ___           ___
//├─────────────┼─────────────┼─────────────┼─────────────┼─────────────┼─────────────┼─────────────╮ ╭─────────────┼─────────────┼─────────────┼─────────────┼─────────────┼─────────────┼─────────────┤
    ___           ___           ___           ___           ___           ___           ___             ___           ___           &kp N1        &kp N2        &kp N3        ___           ___
//╰─────────────┴─────────────┴─────────────┼─────────────┼─────────────┼─────────────┼─────────────┤ ├─────────────┼─────────────┼─────────────┼─────────────┼─────────────┴─────────────┴─────────────╯
                                              ___           ___           ___           ___             ___           ___           &kp N0        &kp KP_DOT
//                                          ╰─────────────┴─────────────┴─────────────┴─────────────╯ ╰─────────────┴─────────────┴─────────────┴─────────────╯
)

ZMK_LAYER(Sys,
//╭─────────────┬─────────────┬─────────────┬─────────────┬─────────────┬─────────────╮                             ╭─────────────┬─────────────┬─────────────┬─────────────┬─────────────┬─────────────╮
    ___           ___           ___           ___           ___           ___                                         ___           ___           ___           ___           ___           ___
//├─────────────┼─────────────┼─────────────┼─────────────┼─────────────┼─────────────┤                             ├─────────────┼─────────────┼─────────────┼─────────────┼─────────────┼─────────────┤
    ___           _BT_SEL_KEYS_                                                                                       ___           ___           ___           ___           ___           ___
//├─────────────┼─────────────┼─────────────┼─────────────┼─────────────┼─────────────┤                             ├─────────────┼─────────────┼─────────────┼─────────────┼─────────────┼─────────────┤
    ___           ___           ___           ___           ___           &bootloader                                 &bootloader   ___           ___           ___           ___           ___
//├─────────────┼─────────────┼─────────────┼─────────────┼─────────────┼─────────────┼─────────────╮ ╭─────────────┼─────────────┼─────────────┼─────────────┼─────────────┼─────────────┼─────────────┤
    ___           ___           ___           ___           ___           &sys_reset    ___             ___           &sys_reset    ___           ___           ___           ___           ___
//╰─────────────┴─────────────┴─────────────┼─────────────┼─────────────┼─────────────┼─────────────┤ ├─────────────┼─────────────┼─────────────┼─────────────┼─────────────┴─────────────┴─────────────╯
                                              ___           ___           ___           ___             ___           ___           ___           ___
//                                          ╰─────────────┴─────────────┴─────────────┴─────────────╯ ╰─────────────┴─────────────┴─────────────┴─────────────╯
)

ZMK_LAYER(Mouse,
//╭─────────────┬─────────────┬─────────────┬─────────────┬─────────────┬─────────────╮                             ╭─────────────┬─────────────┬─────────────┬─────────────┬─────────────┬─────────────╮
    ___           ___           ___           ___           ___           ___                                         ___           ___           ___           ___           ___           ___
//├─────────────┼─────────────┼─────────────┼─────────────┼─────────────┼─────────────┤                             ├─────────────┼─────────────┼─────────────┼─────────────┼─────────────┼─────────────┤
    ___           ___           ___           ___           ___           ___                                         ___           &kp PG_UP     U_MS_U        &kp PG_DN     ___           ___
//├─────────────┼─────────────┼─────────────┼─────────────┼─────────────┼─────────────┤                             ├─────────────┼─────────────┼─────────────┼─────────────┼─────────────┼─────────────┤
    ___           ___           ___           ___           ___           ___                                         U_WH_L        U_MS_L        U_MS_D        U_MS_R        U_WH_R        ___
//├─────────────┼─────────────┼─────────────┼─────────────┼─────────────┼─────────────┼─────────────╮ ╭─────────────┼─────────────┼─────────────┼─────────────┼─────────────┼─────────────┼─────────────┤
    ___           ___           ___           ___           ___           ___           ___             ___           ___           &mkp LCLK     &mkp MCLK     &mkp RCLK     ___           ___
//╰─────────────┴─────────────┴─────────────┼─────────────┼─────────────┼─────────────┼─────────────┤ ├─────────────┼─────────────┼─────────────┼─────────────┼─────────────┴─────────────┴─────────────╯
                                              &mkp LCLK     &mkp RCLK     ___           ___             U_WH_U        U_WH_D        ___           ___
//                                          ╰─────────────┴─────────────┴─────────────┴─────────────╯ ╰─────────────┴─────────────┴─────────────┴─────────────╯
)


/* vim: set ft=c tw=200: */
